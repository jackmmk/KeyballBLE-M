## Kconfig
```kconfig
menuconfig KEYBALL_TRAINER_RAW_HID
    bool "Keyball trainer raw HID telemetry"
    depends on RAW_HID
    help
      Sends ZMK physical key position events to the companion trainer app.

if KEYBALL_TRAINER_RAW_HID

config KEYBALL_TRAINER_RAW_HID_REPORT_SIZE
    int
    default 32

endif
```

## config/west.yml
```yaml
manifest:
  remotes:
    - name: zmkfirmware
      url-base: https://github.com/zmkfirmware
    - name: sayu-hub  # pmw3610-driver のフォーク
      url-base: https://github.com/sayu-hub
    - name: Dist16384   # あなたのフォーク
      url-base: https://github.com/Dist16384
    - name: zzeneg
      url-base: https://github.com/zzeneg

  projects:
    - name: zmk
      remote: zmkfirmware
      revision: v0.3
      path: zmk
      import: app/west.yml
    - name: zmk-pmw3610-driver
      remote: Dist16384
      revision: 30da78323312d31429f21576e890412ecbac3bdf
      path: modules/zmk-pmw3610-driver
    - name: zmk-raw-hid
      remote: zzeneg
      revision: e25e325adc90fccb60cc08393b8c2b0ba6d647c7
      path: modules/zmk-raw-hid

  self:
    path: config
```
